## configs/orangepi_zero3_defconfig
```kconfig
CONFIG_ARM=y
CONFIG_ARCH_SUNXI=y
CONFIG_DEFAULT_DEVICE_TREE="sun50i-h616-orangepi-zero3"
CONFIG_SPL=y
CONFIG_DRAM_SUN50I_H616_DX_ODT=0x70707070
CONFIG_DRAM_SUN50I_H616_DX_DRI=0xe4e4e4e4
CONFIG_DRAM_SUN50I_H616_CA_DRI=0xeeee
CONFIG_DRAM_SUN50I_H616_TPR10=0x00030000

CONFIG_MACH_SUN50I_H616=y
CONFIG_SUNXI_DRAM_H616_LPDDR4=y
CONFIG_R_I2C_ENABLE=y
CONFIG_SPL_SPI_SUNXI=y
# CONFIG_SYS_MALLOC_CLEAR_ON_INIT is not set
CONFIG_SPL_I2C=y
CONFIG_SPL_SYS_I2C_LEGACY=y
CONFIG_SYS_I2C_MVTWSI=y
CONFIG_SYS_I2C_SLAVE=0x7f
CONFIG_SYS_I2C_SPEED=400000
CONFIG_SPI_FLASH_MACRONIX=y
# CONFIG_PHY_MOTORCOMM=y
CONFIG_SUN8I_EMAC=y
CONFIG_SPI=y
# CONFIG_USB_EHCI_HCD=y
# CONFIG_USB_OHCI_HCD=y
# CONFIG_USB_MUSB_GADGET=y
CONFIG_AXP313A_POWER=y
CONFIG_AXP_DCDC3_VOLT=1100
CONFIG_DRAM_CLK=792
```
